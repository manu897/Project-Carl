## build/Kconfig/Kconfig.modules
```kconfig
menu "nrf (/Users/fwdev/Desktop/Github/Project-Carl/external/nrf)"
osource "/Users/fwdev/Desktop/Github/Project-Carl/external/nrf/Kconfig.nrf"
config ZEPHYR_NRF_MODULE
	bool
	default y
endmenu
menu "mcuboot (/Users/fwdev/Desktop/Github/Project-Carl/external/bootloader/mcuboot)"
osource "$(ZEPHYR_MCUBOOT_KCONFIG)"
config ZEPHYR_MCUBOOT_MODULE
	bool
	default y
endmenu
menu "mbedtls (/Users/fwdev/Desktop/Github/Project-Carl/external/modules/crypto/mbedtls)"
osource "$(ZEPHYR_MBEDTLS_KCONFIG)"
config ZEPHYR_MBEDTLS_MODULE
	bool
	default y
endmenu
menu "trusted-firmware-m (/Users/fwdev/Desktop/Github/Project-Carl/external/modules/tee/tf-m/trusted-firmware-m)"
osource "$(ZEPHYR_TRUSTED_FIRMWARE_M_KCONFIG)"
config ZEPHYR_TRUSTED_FIRMWARE_M_MODULE
	bool
	default y
endmenu
config ZEPHYR_PSA_ARCH_TESTS_MODULE
   bool
   default y
menu "cjson (/Users/fwdev/Desktop/Github/Project-Carl/external/modules/lib/cjson)"
osource "$(ZEPHYR_CJSON_KCONFIG)"
config ZEPHYR_CJSON_MODULE
	bool
	default y
endmenu
menu "azure-sdk-for-c (/Users/fwdev/Desktop/Github/Project-Carl/external/modules/lib/azure-sdk-for-c)"
osource "$(ZEPHYR_AZURE_SDK_FOR_C_KCONFIG)"
config ZEPHYR_AZURE_SDK_FOR_C_MODULE
	bool
	default y
endmenu
menu "cirrus-logic (/Users/fwdev/Desktop/Github/Project-Carl/external/modules/hal/cirrus-logic)"
osource "/Users/fwdev/Desktop/Github/Project-Carl/external/modules/hal/cirrus-logic/Kconfig"
config ZEPHYR_CIRRUS_LOGIC_MODULE
	bool
	default y
endmenu
menu "openthread (/Users/fwdev/Desktop/Github/Project-Carl/external/modules/lib/openthread)"
osource "$(ZEPHYR_OPENTHREAD_KCONFIG)"
config ZEPHYR_OPENTHREAD_MODULE
	bool
	default y
endmenu
menu "memfault-firmware-sdk (/Users/fwdev/Desktop/Github/Project-Carl/external/modules/lib/memfault-firmware-sdk)"
osource "/Users/fwdev/Desktop/Github/Project-Carl/external/modules/lib/memfault-firmware-sdk/ports/zephyr/Kconfig"
config ZEPHYR_MEMFAULT_FIRMWARE_SDK_MODULE
	bool
	default y
endmenu
menu "canopennode (/Users/fwdev/Desktop/Github/Project-Carl/external/modules/lib/canopennode)"
osource "$(ZEPHYR_CANOPENNODE_KCONFIG)"
config ZEPHYR_CANOPENNODE_MODULE
	bool
	default y
endmenu
menu "chre (/Users/fwdev/Desktop/Github/Project-Carl/external/modules/lib/chre)"
osource "/Users/fwdev/Desktop/Github/Project-Carl/external/modules/lib/chre/platform/zephyr/Kconfig"
config ZEPHYR_CHRE_MODULE
	bool
	default y
endmenu
menu "lz4 (/Users/fwdev/Desktop/Github/Project-Carl/external/modules/lib/lz4)"
osource "$(ZEPHYR_LZ4_KCONFIG)"
config ZEPHYR_LZ4_MODULE
	bool
	default y
endmenu
menu "nanopb (/Users/fwdev/Desktop/Github/Project-Carl/external/modules/lib/nanopb)"
osource "$(ZEPHYR_NANOPB_KCONFIG)"
config ZEPHYR_NANOPB_MODULE
	bool
	default y
endmenu
config ZEPHYR_TF_M_TESTS_MODULE
   bool
   default y
menu "zscilib (/Users/fwdev/Desktop/Github/Project-Carl/external/modules/lib/zscilib)"
osource "/Users/fwdev/Desktop/Github/Project-Carl/external/modules/lib/zscilib/Kconfig.zscilib"
config ZEPHYR_ZSCILIB_MODULE
	bool
	default y
endmenu
menu "cmsis (/Users/fwdev/Desktop/Github/Project-Carl/external/modules/hal/cmsis)"
osource "$(ZEPHYR_CMSIS_KCONFIG)"
config ZEPHYR_CMSIS_MODULE
	bool
	default y
endmenu
menu "cmsis-dsp (/Users/fwdev/Desktop/Github/Project-Carl/external/modules/lib/cmsis-dsp)"
osource "$(ZEPHYR_CMSIS_DSP_KCONFIG)"
config ZEPHYR_CMSIS_DSP_MODULE
	bool
	default y
endmenu
menu "cmsis-nn (/Users/fwdev/Desktop/Github/Project-Carl/external/modules/lib/cmsis-nn)"
osource "$(ZEPHYR_CMSIS_NN_KCONFIG)"
config ZEPHYR_CMSIS_NN_MODULE
	bool
	default y
endmenu
menu "fatfs (/Users/fwdev/Desktop/Github/Project-Carl/external/modules/fs/fatfs)"
osource "$(ZEPHYR_FATFS_KCONFIG)"
config ZEPHYR_FATFS_MODULE
	bool
	default y
endmenu
menu "hal_nordic (/Users/fwdev/Desktop/Github/Project-Carl/external/modules/hal/nordic)"
osource "$(ZEPHYR_HAL_NORDIC_KCONFIG)"
config ZEPHYR_HAL_NORDIC_MODULE
	bool
	default y
endmenu
config ZEPHYR_ST_MODULE
   bool
   default y
config ZEPHYR_HAL_WURTHELEKTRONIK_MODULE
   bool
   default y
config ZEPHYR_LIBMETAL_MODULE
   bool
   default y
menu "liblc3 (/Users/fwdev/Desktop/Github/Project-Carl/external/modules/lib/liblc3)"
osource "$(ZEPHYR_LIBLC3_KCONFIG)"
config ZEPHYR_LIBLC3_MODULE
	bool
	default y
endmenu
menu "littlefs (/Users/fwdev/Desktop/Github/Project-Carl/external/modules/fs/littlefs)"
osource "$(ZEPHYR_LITTLEFS_KCONFIG)"
config ZEPHYR_LITTLEFS_MODULE
	bool
	default y
endmenu
menu "loramac-node (/Users/fwdev/Desktop/Github/Project-Carl/external/modules/lib/loramac-node)"
osource "$(ZEPHYR_LORAMAC_NODE_KCONFIG)"
config ZEPHYR_LORAMAC_NODE_MODULE
	bool
	default y
endmenu
menu "lvgl (/Users/fwdev/Desktop/Github/Project-Carl/external/modules/lib/gui/lvgl)"
osource "/Users/fwdev/Desktop/Github/Project-Carl/external/modules/lib/gui/lvgl/Kconfig"
config ZEPHYR_LVGL_MODULE
	bool
	default y
endmenu
config ZEPHYR_MIPI_SYS_T_MODULE
   bool
   default y
config ZEPHYR_NRF_HW_MODELS_MODULE
   bool
   default y
config ZEPHYR_OPEN_AMP_MODULE
   bool
   default y
menu "picolibc (/Users/fwdev/Desktop/Github/Project-Carl/external/modules/lib/picolibc)"
osource "/Users/fwdev/Desktop/Github/Project-Carl/external/modules/lib/picolibc/zephyr/Kconfig"
config ZEPHYR_PICOLIBC_MODULE
	bool
	default y
endmenu
menu "segger (/Users/fwdev/Desktop/Github/Project-Carl/external/modules/debug/segger)"
osource "$(ZEPHYR_SEGGER_KCONFIG)"
config ZEPHYR_SEGGER_MODULE
	bool
	default y
endmenu
config ZEPHYR_TINYCRYPT_MODULE
   bool
   default y
menu "uoscore-uedhoc (/Users/fwdev/Desktop/Github/Project-Carl/external/modules/lib/uoscore-uedhoc)"
osource "$(ZEPHYR_UOSCORE_UEDHOC_KCONFIG)"
config ZEPHYR_UOSCORE_UEDHOC_MODULE
	bool
	default y
endmenu
menu "zcbor (/Users/fwdev/Desktop/Github/Project-Carl/external/modules/lib/zcbor)"
osource "$(ZEPHYR_ZCBOR_KCONFIG)"
config ZEPHYR_ZCBOR_MODULE
	bool
	default y
endmenu
menu "nrfxlib (/Users/fwdev/Desktop/Github/Project-Carl/external/nrfxlib)"
osource "/Users/fwdev/Desktop/Github/Project-Carl/external/nrfxlib/Kconfig.nrfxlib"
config ZEPHYR_NRFXLIB_MODULE
	bool
	default y
endmenu
menu "connectedhomeip (/Users/fwdev/Desktop/Github/Project-Carl/external/modules/lib/matter)"
osource "/Users/fwdev/Desktop/Github/Project-Carl/external/modules/lib/matter/config/nrfconnect/chip-module/Kconfig"
config ZEPHYR_CONNECTEDHOMEIP_MODULE
	bool
	default y
endmenu
```

## build/Kconfig/Kconfig.shield
```kconfig
osource "/Users/fwdev/Desktop/Github/Project-Carl/external/nrf/boards/shields/*/Kconfig.shield"
```

## build/empty_net_core/Kconfig/Kconfig.sysbuild.modules
```kconfig
menu "nrf (/Users/fwdev/Desktop/Github/Project-Carl/external/nrf)"
osource "/Users/fwdev/Desktop/Github/Project-Carl/external/nrf/sysbuild/Kconfig.sysbuild"
config ZEPHYR_NRF_MODULE
	bool
	default y
endmenu
```
